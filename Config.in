## Config.in
```kconfig
source "$BR2_EXTERNAL_CRAMPS_PATH/package/python-adafruit_bbio/Config.in"
source "$BR2_EXTERNAL_CRAMPS_PATH/package/python-evdev/Config.in"
source "$BR2_EXTERNAL_CRAMPS_PATH/package/python-redeem/Config.in"
```

## package/python-redeem/Config.in
```kconfig
config BR2_PACKAGE_PYTHON_REDEEM
	bool "python-redeem"
	select BR2_PACKAGE_PYTHON_EVDEV
	select BR2_PACKAGE_PYTHON_ADAFRUIT_BBIO
	select BR2_PACKAGE_PYTHON_NUMPY
	help
	  A module to control BeagleBone IO channels.
	  Redeem is the Replicape Daemon that accepts
	  G-codes and turns them into coordinates on
	  your 3D-printer. It's similar to Marlin and 
	  Teacup, only it's taylor made for Replicape
	  and it's written in Python.

	  https://github.com/intelligent-agent/redeem
```
